## config/west.yml
```yaml
manifest:
  remotes:
    - name: origin
      url-base: https://github.com/AmmarAbouZor
    - name: zmkfirmware
      url-base: https://github.com/zmkfirmware
  projects:
    - name: zmk
      remote: origin
      revision: keychron_bpro
      import: app/west.yml
  self:
    path: config
```
